## sdkconfig.defaults
```kconfig
# BLE - NimBLE dual-role
CONFIG_BT_ENABLED=y
CONFIG_BT_NIMBLE_ENABLED=y
CONFIG_BT_NIMBLE_ROLE_CENTRAL=y
CONFIG_BT_NIMBLE_ROLE_PERIPHERAL=y
CONFIG_BT_NIMBLE_ROLE_OBSERVER=y
CONFIG_BT_NIMBLE_ROLE_BROADCASTER=y
CONFIG_BT_NIMBLE_MAX_CONNECTIONS=2

# WiFi + BLE coexistence
CONFIG_ESP32_WIFI_SW_COEXIST_ENABLE=y
CONFIG_ESP_WIFI_TASK_CORE_ID=1
CONFIG_BT_NIMBLE_PINNED_TO_CORE=0

# WiFi
CONFIG_ESP_WIFI_SOFTAP_ENABLED=y

# HTTP server
CONFIG_HTTPD_MAX_REQ_HDR_LEN=512

# WiFi power save - modem sleep between beacons
CONFIG_ESP_WIFI_SLP_IRAM_OPT=y

# Reduce static WiFi buffers (default dynamic=128, static=0)
CONFIG_ESP_WIFI_STATIC_RX_BUFFER_NUM=6
CONFIG_ESP_WIFI_DYNAMIC_RX_BUFFER_NUM=16
CONFIG_ESP_WIFI_DYNAMIC_TX_BUFFER_NUM=16

# BLE - reduce scan duplicate list (saves ~1KB)
CONFIG_BT_NIMBLE_MAX_SCAN_RSP_DATA_LEN=31

# Logging
CONFIG_LOG_DEFAULT_LEVEL_INFO=y

# Task watchdog
CONFIG_ESP_TASK_WDT_EN=y
CONFIG_ESP_TASK_WDT_TIMEOUT_S=10
CONFIG_ESP_TASK_WDT_CHECK_IDLE_TASK_CPU0=y
CONFIG_ESP_TASK_WDT_CHECK_IDLE_TASK_CPU1=y
```
